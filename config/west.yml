## config/west.yml
```yaml
manifest:
  remotes:
    - name: zmkfirmware
      url-base: https://github.com/zmkfirmware
    - name: badjeff
      url-base: https://github.com/badjeff
          # Додавання підтримки nice OLED
    - name: mctechnology17
      url-base: https://github.com/mctechnology17
    - name: semtexfromua
      url-base: https://github.com/semtexfromua
  # Pinned to the proven pre-Zephyr-4.1 snapshot (same set that builds charybdis_4x6
  # green). ZMK main is now on Zephyr 4.1 and breaks this trackball config.
  # Bump these SHAs deliberately when upgrading.
  projects:
    - name: zmk
      remote: zmkfirmware
      revision: 4ec69cb7e658590adf6354027aca789b364a70c5  # main @ 2025-09-30
      import: app/west.yml
    - name: zmk-pmw3610-driver
      remote: badjeff
      revision: 77635bad95097e2ed6fc16624622cff025a0e33b  # main @ 2025-09-26
    - name: zmk-split-peripheral-input-relay
      remote: badjeff
      revision: f49a5ca22a7b5626e37cffc73e97e64945bf9eb0  # main @ 2024-12-12
    - name: zmk-input-behavior-listener-custom
      remote: semtexfromua
      revision: c7f153368655aff015f9597a8e0c92522c6414d1  # main @ 2025-06-12 (proven; bump for newer fork behaviour)
          # Додавання nice OLED модуля
    - name: zmk-nice-oled
      remote: mctechnology17
      revision: 5d7dce25735277dd6dcd8295c64e143d4f95cdfa  # main @ 2025-03-24
  self:
    path: config
```
